/********************************* 深圳市航太电子有限公司 *******************************
* 实 验 名 ：操作系统ucosii实验
* 实验说明 ：创建两个任务，实现两个LED灯以不同频率闪烁，并以9600波特率发送数据到串口调试助手
* 实验平台 ：航太51单片机开发板 V1.2
* 连接方式 ：
* 注    意 ：1.本系统使用的心跳时钟是10ms
*            2.编译时可能会出现unreachable code警告，为正常现象
* 作    者 ：航太电子产品研发部    QQ ：1909197536
* 店    铺 ：http://shop120013844.taobao.com/
****************************************************************************************/
#include"includes.h"

//IO接口定义
sbit LED0 = P1^0;
sbit LED1 = P1^1;

OS_STK Task1Stk[MaxStkSize]; //创建任务堆栈
OS_STK Task2Stk[MaxStkSize];

char putchar(char ch)
{ 
	/* Place your implementation of fputc here */ 
	SBUF=(unsigned char)ch; //将接收到的数据放入到发送寄存器
	while(!TI);		  //等待发送数据完成
	TI=0;		 //清除发送完成标志位	
	return ch;
}

/*******************************************************************************
* 函 数 名 ：Task1
* 函数功能 ：任务1，循环执行，由系统定时器调度
* 输    入 ：无
* 输    出 ：无
*******************************************************************************/
void Task1(void* ddata) reentrant
{
	ddata = ddata;
	while (1)
	{
		LED0 = ~LED0;
		OS_ENTER_CRITICAL();
		printf("********Task1*****\r\n");//串口发送数据时最好不要被中断
		OS_EXIT_CRITICAL();
		OSTimeDly(50);   //50*10 500ms 在11.0592M晶振下，需要约33.4MS切换一次任务，OSTimeDly(1);最小切换任务时间
	}
}

/*******************************************************************************
* 函 数 名 ：Task2
* 函数功能 ：任务2，循环执行，由系统定时器调度
* 输    入 ：无
* 输    出 ：无
*******************************************************************************/
void Task2(void* ddata) reentrant
{
	ddata = ddata;
	while (1)
	{
		LED1 = ~LED1;
		OS_ENTER_CRITICAL();
		printf("********Task2**********\r\n");
		OS_EXIT_CRITICAL();
		OSTimeDly(100);//100*10 1s	
		
	}
}

/*******************************************************************************
* 函 数 名 ：main
* 函数功能 ：主函数
* 输    入 ：无
* 输    出 ：无
*******************************************************************************/
void main(void)
{
	P1 = 0xff;
	OSInit();
	InitTimer0();
	init_UART();
	OSTaskCreate(Task1, (void *) 0, &Task1Stk[0], 1);
	OSTaskCreate(Task2, (void *) 0, &Task2Stk[0], 2);
	OSStart();
}

