/********************************* 深圳市航太电子有限公司 *******************************
* 实 验 名 ：蜂鸣器实验
* 实验说明 ：蜂鸣器自动播放歌曲
* 实验平台 ：航太51单片机开发板 V1.2
* 连接方式 ：短路帽CN3 引脚1,3短接
* 注    意 ：
* 作    者 ：航太电子产品研发部    QQ ：1909197536
* 店    铺 ：http://shop120013844.taobao.com/
****************************************************************************************/
#include <reg52.h>
#include <intrins.h>

#define FOSC 11059200L //晶振设置，默认使用11.0592M Hz
//#define FOSC 12000000L //晶振设置，使用12M Hz
//#define FOSC 24000000L //晶振设置，使用24M Hz
#define T10MS (65536-FOSC/12/100)   //10ms 定时


//IO接口定义
sbit speak_IO =P1^5 ;               //蜂鸣器控制脚　

//全局变量定义
unsigned char count;
unsigned char code SONG[] ={      //祝你平安
	0x26,0x20,0x20,0x20,0x20,0x20,0x26,0x10,0x20,0x10,0x20,0x80,
	0x26,0x20,0x30,0x20,0x30,0x20,0x39,0x10,0x30,0x10,0x30,0x80,
	0x26,0x20,0x20,0x20,0x20,0x20,0x1c,0x20,0x20,0x80,0x2b,0x20,
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	0x20,0x10,0x2b,0x10,0x26,0x30,0x30,0x80,0x00,
	//路边的野华不要采
	0x30,0x1C,0x10,0x20,0x40,0x1C,0x10,0x18,0x10,0x20,0x10,0x1C,
	0x10,0x18,0x40,0x1C,0x20,0x20,0x20,0x1C,0x20,0x18,0x20,0x20,
	0x80,0xFF,0x20,0x30,0x1C,0x10,0x18,0x20,0x15,0x20,0x1C,0x20,
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	0x80,0x00,
};

/*******************************************************************************
* 函 数 名 ：Delayms
* 函数功能 ：实现 ms级的延时
* 输    入 ：ms
* 输    出 ：无
*******************************************************************************/
void Delayms(unsigned int ms)
{
	unsigned int i,j;
	for(i=0;i<ms;i++)
	#if FOSC == 11059200L
	for(j=0;j<114;j++);
	#elif FOSC == 12000000L
	for(j=0;j<123;j++);
	#elif FOSC == 24000000L
	for(j=0;j<249;j++);
	#else
	for(j=0;j<114;j++);
	#endif
}

/*******************************************************************************
* 函 数 名 ：Delayus
* 函数功能 ：us级延时
* 输    入 ：无
* 输    出 ：无
*******************************************************************************/
void Delayus(unsigned int us)
{
	  unsigned int i,j;

    for( i =0;i < us;i++ )

    {
        for( j =0;j<3;j++ );
    }	
}


/*******************************************************************************
* 函 数 名 ：Time0_Init
* 函数功能 ：定时器0初始化
* 输    入 ：无
* 输    出 ：无
*******************************************************************************/
void Time0Init()  
{
	TMOD = 0x01;  //工作模式选择
	IE = 0x82;  //中断设置
	TH0  = T10MS>>8;   //装初值,延时10ms
	TL0  = T10MS; 
}

/*******************************************************************************
* 函 数 名 ：Time0Int
* 函数功能 ：count 10ms计数
* 输    入 ：无
* 输    出 ：无
*******************************************************************************/
void Time0Int() interrupt 1  //定时器0中断子函数
{
	TH0  = T10MS>>8;   //装初值,延时10ms
	TL0  = T10MS; 
	count++;              //长度加1
}

/*******************************************************************************
* 函 数 名 ：PlaySong
* 函数功能 ：歌曲播放子程序i为播放哪一段曲目
* 输    入 ：无
* 输    出 ：无
*******************************************************************************/
void PlaySong(unsigned char i)
{
	unsigned char Temp1,Temp2;
	unsigned int Addr;
	count = 0;                               //中断计数器清0
	Addr = i * 217;
	while(1)
	{
		Temp1 = SONG[Addr++];  //读取频率
		if ( Temp1 == 0xFF )          //休止符
		{
			TR0 = 0;
			Delayus(100);
		}
		else if ( Temp1 == 0x00 )   //歌曲结束符
		{
			return;
		}
		else
		{
			Temp2 = SONG[Addr++];//读取一个音的时长
			TR0 = 1;
			while(1)
			{
				speak_IO = ~speak_IO;
				Delayus(Temp1);
				if ( Temp2 == count )//一个音结束
				{
					count = 0;
					break;
				}
			}
		}
	}
}

/*******************************************************************************
* 函 数 名 ：main
* 函数功能 ：主函数
* 输    入 ：无
* 输    出 ：无
*******************************************************************************/
void main()
{
	Time0Init();   //定时器0中断初始化
	
	while(1)
	{
		PlaySong(0);       //播放第一首歌
		Delayms(1000);
		PlaySong(1);       //播放第二首歌
	}
}

