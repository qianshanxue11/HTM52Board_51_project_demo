/********************************* 深圳市航太电子有限公司 *******************************
* 实 验 名 ：单键识别实验
* 实验说明 ：点击按键S17松开后，流水灯自动往下循环
* 实验平台 ：航太51单片机开发板 V1.2
* 连接方式 ：短路帽CN14 引脚1,2短接
* 注    意 ：
* 作    者 ：航太电子产品研发部    QQ ：1909197536
* 店    铺 ：http://shop120013844.taobao.com/
****************************************************************************************/

#include <reg52.h>
#include <intrins.h>

#define FOSC 11059200L //晶振设置，默认使用11.0592M Hz
//#define FOSC 12000000L //晶振设置，使用12M Hz
//#define FOSC 24000000L //晶振设置，使用24M Hz

//设置IO接口
sbit key=P3^4;   //定义按键的输入端S17键

//设置全局变量
unsigned char a,b,k;
unsigned char count; //按键计数,每按一下,count加1
unsigned char temp;
unsigned char a,b;

/*******************************************************************************
* 函 数 名 ：Delayms
* 函数功能 ：实现 ms级的延时
* 输    入 ：ms
* 输    出 ：无
*******************************************************************************/
void Delayms(unsigned int ms)
{
	unsigned int i,j;
	for(i=0;i<ms;i++)
	#if FOSC == 11059200L
	for(j=0;j<114;j++);
	#elif FOSC == 12000000L
	for(j=0;j<123;j++);
	#elif FOSC == 24000000L
	for(j=0;j<249;j++);
	#else
	for(j=0;j<114;j++);
	#endif
}

/*******************************************************************************
* 函 数 名 ：KeyScan
* 函数功能 ：按键判断程序
* 输    入 ：无
* 输    出 ：无
*******************************************************************************/
void KeyScan() 
{
	if(key==0)  //判断是否按下键盘
	{
		Delayms(10); //延时,软件去干扰
		if(key==0)   //确认按键按下
		{
			count++;     //按键计数加1
			if(count==8) //计8次重新计数
			{
				count=0;    //将count清零
			}
		}
		while(key==0);//按键锁定,每按一次count只加1.
	}
}

/*******************************************************************************
* 函 数 名 ：Move
* 函数功能 ：控制LED灯根据 KeyScan 得到的结果点亮
* 输    入 ：无
* 输    出 ：无
*******************************************************************************/
void Move()         //流水灯向左移动移动函数
{
	a=temp<<count;
	b=temp>>(8-count);
	P1=a|b;
}

/*******************************************************************************
* 函 数 名 ：main
* 函数功能 ：主函数
* 输    入 ：无
* 输    出 ：无
*******************************************************************************/
void main()
{
	count=0;  //初始华参数设置
	temp=0xfe;
	P1=0xff;
	P1=temp;
	while(1)  //永远循环,扫描判断按键是否按下
	{
		KeyScan();    //调用按键识别函数
		Move();   //调用流水灯移动函数
	}
}
