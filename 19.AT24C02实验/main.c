/********************************* 深圳市航太电子有限公司 *******************************
* 实 验 名 ：AT24C02实验
* 实验说明 ：按秒循环计数，显示到数码管，并记录当前计数到24C02，下次启动时直接从上次的计数值开始计数
* 实验平台 ：航太51单片机开发板 V1.2
* 连接方式 ：
* 注    意 ：数码管采用供阳模式，位选和段选时要输出高电平
* 作    者 ：航太电子产品研发部    QQ ：1909197536
* 店    铺 ：http://shop120013844.taobao.com/
****************************************************************************************/

#include <reg52.h>
#include <intrins.h>

#define FOSC 11059200L //晶振设置，默认使用11.0592M Hz
//#define FOSC 12000000L //晶振设置，使用12M Hz
//#define FOSC 24000000L //晶振设置，使用24M Hz

#define TIME_MS 50 //设定定时时间 ms ,在11.0592M晶振下，不易超过60ms

/**************IO接口定义******************/
//数码管接口
#define LED_PORT P0
sbit dula=P2^6;
sbit wela=P2^7;

//AT24C02接口
bit  write_flag=0;			  //写24C08的标志；
sbit X24_sda=P2^0;			 //IO口定义
sbit X24_scl=P2^1;

//全局变量定义
unsigned char sec_count;		  //定义计数值，每过1秒，sec_count加1
unsigned int tcnt;		  //定时中断次数

//LED显示字模 0-F 共阳模式
unsigned char code table[]= {0Xc0,0xf9,0xa4,0xb0,0x99,0x92,0x82,0xf8,0x80,0x90,0x88,0x83,0xc6,0xa1,0x86,0x8e};

/*******************************************************************************
* 函 数 名 ：Delayms
* 函数功能 ：实现 ms级的延时
* 输    入 ：ms
* 输    出 ：无
*******************************************************************************/
void Delayms(unsigned int ms)
{
	unsigned int i,j;
	for(i=0;i<ms;i++)
	#if FOSC == 11059200L
		for(j=0;j<114;j++);
	#elif FOSC == 12000000L
	  for(j=0;j<123;j++);
	#elif FOSC == 24000000L
		for(j=0;j<249;j++);
	#else
		for(j=0;j<114;j++);
	#endif
}

/*******************************************************************************
* 函 数 名 ：Delayus
* 函数功能 ：实现 us级的延时
* 输    入 ：us
* 输    出 ：无
*******************************************************************************/
void Delayus(unsigned int us)
{
	unsigned int i;
	for(i=0;i<us;i++);
}

/*******************************************************************************
* 函 数 名 ：Timer0Init
* 函数功能 ：定时器0初始化
* 输    入 ：无
* 输    出 ：无
*******************************************************************************/
void Timer0Init()
{
	TMOD=0x01; //设置定时器0工作方式为1
	TH0=(65536-FOSC/12/1000*TIME_MS)/256;
	TL0=(65536-FOSC/12/1000*TIME_MS)%256;
	ET0=1; //开启定时器0中断
	TR0=1;	//开启定时器	
	EA=1;  //打开总中断
}

/*******************************************************************************
* 函 数 名 ：LEDdisplay
* 函数功能 ：循环显示各个位上的数据
* 输    入 ：bai 百位  shi 十位  个 位
* 输    出 ：无
*******************************************************************************/
void LEDdisplay(unsigned int num)
{
	unsigned char bai,shi,ge;
	bai=num/100;
	shi=num%100/10;
	ge=num%10;
	
	wela=1;
	LED_PORT=0x01;
	wela=0;	
	dula=1;			   //显示百位
	LED_PORT=table[bai];
	dula=0;
	Delayms(1);
	
	wela=1;
	LED_PORT=0x02;
	wela=0;
	dula=1;			   //显示十位
	LED_PORT=table[shi];	 
	dula=0;
	Delayms(1);
	
	wela=1;
	LED_PORT=0x04;
	wela=0;
	dula=1;			 // 显示个位
	LED_PORT=table[ge];
	dula=0;
	Delayms(1);
}

/////////24C08读写驱动程序////////////////////
/*******************************************************************************
* 函 数 名 ：X24c02Init
* 函数功能 ：24C02初始化子程序
* 输    入 ：无
* 输    出 ：无
*******************************************************************************/
void X24c02Init()
{
	X24_scl=1; _nop_(); X24_sda=1; _nop_();
}

/*******************************************************************************
* 函 数 名 ：X24c02Start
* 函数功能 ：启动24c02 I2C总线
* 输    入 ：无
* 输    出 ：无
*******************************************************************************/
void X24c02Start()		
{
	X24_sda=1; _nop_(); X24_scl=1; _nop_(); X24_sda=0; _nop_(); X24_scl=0; _nop_();
}

/*******************************************************************************
* 函 数 名 ：X24c02Stop
* 函数功能 ：停止I2C总线
* 输    入 ：无
* 输    出 ：无
*******************************************************************************/
void X24c02Stop() 		
{
	X24_sda=0; _nop_(); X24_scl=1; _nop_(); X24_sda=1; _nop_();
}

/*******************************************************************************
* 函 数 名 ：X24c02WriteByte
* 函数功能 ：写一个字节
* 输    入 ：j 需要写入的值
* 输    出 ：无
*******************************************************************************/
void X24c02WriteByte(unsigned char j)  
{
	unsigned char i,temp;
	temp=j;
	for (i=0;i<8;i++)
	{temp=temp<<1; X24_scl=0; _nop_(); X24_sda=CY; _nop_(); X24_scl=1; _nop_();}
	X24_scl=0; _nop_(); X24_sda=1; _nop_();
}

/*******************************************************************************
* 函 数 名 ：X24c02ReadByte
* 函数功能 ：读一个字节
* 输    入 ：无
* 输    出 ：读取的值
*******************************************************************************/
unsigned char X24c02ReadByte()	
{
	unsigned char i,j,k=0;
	X24_scl=0; _nop_(); X24_sda=1;
	for (i=0;i<8;i++)
	{
		_nop_(); X24_scl=1; _nop_();
		if (X24_sda==1) j=1;
		else j=0;
		k=(k<<1)|j;
		X24_scl=0;
	}
	_nop_(); return(k);
}

/*******************************************************************************
* 函 数 名 ：X24c02Clock
* 函数功能 ：I2C总线时钟
* 输    入 ：无
* 输    出 ：无
*******************************************************************************/
void X24c02Clock()		 
{
	unsigned char i=0;
	X24_scl=1; _nop_();
	while ((X24_sda==1)&&(i<255))i++;
	X24_scl=0; _nop_();
}

/*******************************************************************************
* 函 数 名 ：X24c02ReadAdd
* 函数功能 ：从24c02的地址address中读取一个字节数据
* 输    入 ：address
* 输    出 ：在该地址下读取的值
*******************************************************************************/
unsigned char X24c02ReadAdd(unsigned char address)
{
	unsigned char i;
	X24c02Start(); X24c02WriteByte(0xa0);
	X24c02Clock(); X24c02WriteByte(address);
	X24c02Clock(); X24c02Start();
	X24c02WriteByte(0xa1); X24c02Clock();
	i=X24c02ReadByte(); X24c02Stop();
	Delayus(10);
	return(i);
}

/*******************************************************************************
* 函 数 名 ：X24c02WriteAdd
* 函数功能 ：向24c02的address地址中写入一字节数据
* 输    入 ：address 地址 info 值
* 输    出 ：无
*******************************************************************************/
void X24c02WriteAdd(unsigned char address,unsigned char info)
{
	EA=0;
	X24c02Start(); X24c02WriteByte(0xa0);
	X24c02Clock(); X24c02WriteByte(address);
	X24c02Clock(); X24c02WriteByte(info);
	X24c02Clock(); X24c02Stop();
	EA=1;
	Delayus(50);
}

/*******************************************************************************
* 函 数 名 ：main
* 函数功能 ：主函数
* 输    入 ：无
* 输    出 ：无
*******************************************************************************/
void main()
{
	sec_count = 0;
	tcnt = 0;
	
	Timer0Init();
	X24c02Init();		  //初始化24C02
	sec_count=X24c02ReadAdd(2);//读出保存的数据赋于sec_count
	while(1)
	{ 
		LEDdisplay(sec_count);
		if(write_flag==1) //判断计时器是否计时一秒
		{
			write_flag=0;			   //清零
			X24c02WriteAdd(2,sec_count);	//在24c02的地址2中写入数据sec_count
		}
	}
}

/*******************************************************************************
* 函 数 名 ：Timer0Int
* 函数功能 ：定时器0中断函数 ， 每隔TIME_MS ms进入
* 输    入 ：无
* 输    出 ：无
*******************************************************************************/
void Timer0Int() interrupt 1
{
	TH0=(65536-FOSC/12/1000*TIME_MS)/256;
	TL0=(65536-FOSC/12/1000*TIME_MS)%256;
	tcnt++; 	   //每过250ust tcnt加一
	if(tcnt==20)  //计满20次（1秒）时
	{
		tcnt=0;   //重新再计
		sec_count++;
		write_flag=1;  //1秒写一次24C08
		if(sec_count==100) //定时100秒，在从零开始计时
		{sec_count=0;}
	}	
}

