/********************************* 深圳市航太电子有限公司 *******************************
* 实 验 名 ：舵机实验
* 实验说明 ：舵机左右摇摆
* 实验平台 ：航太51单片机开发板 V1.3
* 连接方式 ：跳线帽CN9 引脚13,14短接 
*            舵机橙色线接COT，红色线接VCC，棕色线接GND
* 注    意 ：1、舵机PWM周期20ms，其中脉冲宽度从0.5ms-2.5ms，相对应舵盘的位置为0－180度，呈线性变化
*            2、程序使用12M晶振，定时器频率0.1ms，变量 angle_count 可调范围为5-25
*		     3、考虑到边界误差，舵机在实际使用时建议使用90度左右的范围，与0度和180度保持适当的距离
* 作    者 ：航太电子产品研发部    QQ ：1909197536
* 店    铺 ：http://shop120013844.taobao.com/
****************************************************************************************/

#include <reg52.h>
#include <intrins.h>

#define FOSC 11059200L //晶振设置，默认使用11.0592M Hz
//#define FOSC 12000000L //晶振设置，使用12M Hz
//#define FOSC 24000000L //晶振设置，使用24M Hz

#define TIME_US 100 //设定定时时间 us 

//IO接口定义
sbit contrl_out=P0^7;

//全局变量定义
unsigned int count,angle_count;

/*******************************************************************************
* 函 数 名 ：Delayms
* 函数功能 ：实现 ms级的延时
* 输    入 ：ms
* 输    出 ：无
*******************************************************************************/
void Delayms(unsigned int ms)
{
	unsigned int i,j;
	for(i=0;i<ms;i++)
	#if FOSC == 11059200L
		for(j=0;j<114;j++);
	#elif FOSC == 12000000L
	  for(j=0;j<123;j++);
	#elif FOSC == 24000000L
		for(j=0;j<249;j++);
	#else
		for(j=0;j<114;j++);
	#endif
}


/*******************************************************************************
* 函 数 名 ：Timer0Init
* 函数功能 ：定时器0初始化
* 输    入 ：无
* 输    出 ：无
*******************************************************************************/
void Timer0Init()
{
	TMOD=0x01; //设置定时器0工作方式为1
	TH0=(65536-(FOSC/12*TIME_US)/1000000)/256;
	TL0=(65536-(FOSC/12*TIME_US)/1000000)%256;
	ET0=1; //开启定时器0中断
	TR0=1;	//开启定时器	
	EA=1;  //打开总中断
}

/*******************************************************************************
* 函 数 名 ：main
* 函数功能 ：主函数
* 输    入 ：无
* 输    出 ：无
*******************************************************************************/
void main()
{
	Timer0Init();
	angle_count=7;
	Delayms(500);//先回原位
	while(1)
	{ 
		for(angle_count=7;angle_count<23;angle_count++)
		Delayms(30);
		for(angle_count=23;angle_count>7;angle_count--)
		Delayms(30);
	}
}

/*******************************************************************************
* 函 数 名 ：Timer0Int
* 函数功能 ：定时器0中断函数 ， 每隔TIME_US ms进入
* 输    入 ：无
* 输    出 ：无
*******************************************************************************/
void Timer0Int() interrupt 1
{
	TH0=(65536-(FOSC/12*TIME_US)/1000000)/256;
	TL0=(65536-(FOSC/12*TIME_US)/1000000)%256;
	count++;
	if(count > 200)
	count=0;
	if(count<angle_count)
	contrl_out=1;
	else
	contrl_out=0;
}
