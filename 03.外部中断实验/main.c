/********************************* 深圳市航太电子有限公司 *******************************
* 实 验 名 ：外部中断实验
* 实验说明 ：点击按钮S1，LED灯会循环点亮和熄灭
* 实验平台 ：航太51单片机开发板 V1.2
* 连接方式 ：使用杜邦线将 CN14 引脚2和单片机的P3^2连接
* 注    意 ：
* 作    者 ：航太电子产品研发部    QQ ：1909197536
* 店    铺 ：http://shop120013844.taobao.com/
****************************************************************************************/

#include <reg52.h>
#include <intrins.h>

#define FOSC 11059200L //晶振设置，默认使用11.0592M Hz
//#define FOSC 12000000L //晶振设置，使用12M Hz
//#define FOSC 24000000L //晶振设置，使用24M Hz

//IO接口定义
sbit key = P3^2;
sbit LED = P1^0;
//全局变量定义


/*******************************************************************************
* 函 数 名 ：Delayms
* 函数功能 ：实现 ms级的延时
* 输    入 ：ms
* 输    出 ：无
*******************************************************************************/
void Delayms(unsigned int ms)
{
	unsigned int i,j;
	for(i=0;i<ms;i++)
	#if FOSC == 11059200L
		for(j=0;j<114;j++);
	#elif FOSC == 12000000L
	  for(j=0;j<123;j++);
	#elif FOSC == 24000000L
		for(j=0;j<249;j++);
	#else
		for(j=0;j<114;j++);
	#endif
}

/*******************************************************************************
* 函 数 名 ：Exit0Init
* 函数功能 ：外中断0初始化程序
* 输    入 ：无
* 输    出 ：无
*******************************************************************************/
void Exit0Init()
{
	EX0 = 1;	//使能 INT1 外部中断
	IT0 = 1;	// 触发方式为脉冲负边沿触发
	EA = 1;//总中断
}  

/*******************************************************************************
* 函 数 名 ：main
* 函数功能 ：主函数
* 输    入 ：无
* 输    出 ：无
*******************************************************************************/
void main()
{
	Exit0Init();
	while(1);	
}

/*******************************************************************************
* 函 数 名 ：Exit0Int
* 函数功能 ：外部中断0 ISR
* 输    入 ：无
* 输    出 ：无
*******************************************************************************/
void Exit0Int() interrupt 0 
{
  EX0 = 0;        //关中断 
  Delayms(30);      //延时30ms，去掉这行会出现按一下中断几次的情况 
  if(key == 0)    //对按键进行抗干扰处理 
  { 
    LED = !LED; 
  } 
  Delayms(30);      //延时300毫秒进行下次检测 
  EX0 = 1;      //开中断 

} 




