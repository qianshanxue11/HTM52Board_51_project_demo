/********************************* 深圳市航太电子有限公司 *******************************
* 实 验 名 ：NE555数码管显示程序
* 实验说明 ：调节电位器RP2，改变NE555输出频率，显示当前NE555的输出频率到数码管上
* 实验平台 ：航太51单片机开发板 V1.2
* 连接方式 ：短路帽CN26 短接引脚1,2
* 注    意 ：做完该实验后，请断开跳线帽CN26，否则会对其他实验有影响
* 作    者 ：航太电子产品研发部    QQ ：1909197536
* 店    铺 ：http://shop120013844.taobao.com/
****************************************************************************************/

#include <reg52.h>
#include <intrins.h>

#define FOSC 11059200L //晶振设置，默认使用11.0592M Hz
//#define FOSC 12000000L //晶振设置，使用12M Hz
//#define FOSC 24000000L //晶振设置，使用24M Hz

#define TIME_MS 50 //设定定时时间 ms ,在11.0592M晶振下，不易超过60ms

//IO接口定义
#define LED_PORT P0
sbit dula=P2^6;
sbit wela=P2^7;

//全局变量定义
unsigned long   Freq;        //用来存放要显示的频率值
unsigned long	TimeCount;   //用于计算1S钟的
unsigned char DisplayData[8];//用来存放要显示的8位数的值

//LED显示字模 0-F 共阳模式
unsigned code table[]= {0Xc0,0xf9,0xa4,0xb0,0x99,0x92,0x82,0xf8,0x80,0x90,0x88,0x83,0xc6,0xa1,0x86,0x8e};

/*******************************************************************************
* 函 数 名 ：Delayms
* 函数功能 ：实现 ms级的延时
* 输    入 ：ms
* 输    出 ：无
*******************************************************************************/
void Delayms(unsigned int ms)
{
	unsigned int i,j;
	for(i=0;i<ms;i++)
	#if FOSC == 11059200L
		for(j=0;j<114;j++);
	#elif FOSC == 12000000L
	  for(j=0;j<123;j++);
	#elif FOSC == 24000000L
		for(j=0;j<249;j++);
	#else
		for(j=0;j<114;j++);
	#endif
}

/*******************************************************************************
* 函 数 名 ：Timer0Init
* 函数功能 ：定时器0初始化
* 输    入 ：无
* 输    出 ：无
*******************************************************************************/
void Timer0Init()
{
	TMOD |= 0x01; //设置定时器0工作方式为1
	TH0=(65536-FOSC/12/1000*TIME_MS)/256;
	TL0=(65536-FOSC/12/1000*TIME_MS)%256;
	ET0=1; //开启定时器0中断
	TR0=1;	//开启定时器	
}

/*******************************************************************************
* 函 数 名 ：Timer1Init
* 函数功能 ：定时器1初始化
* 输    入 ：无
* 输    出 ：无
*******************************************************************************/
void Timer1Init()
{
	TMOD |= 0x50;//--定时器T1做计数器，工作方式1（16位定时器）
	ET1=1;//开启定时器1中断
	TR1=1;//开启定时器	
	EA=1;  //打开总中断
}

/*******************************************************************************
* 函 数 名 ：LEDdisplay
* 函数功能 ：循环显示各个位上的数据
* 输    入 ：无
* 输    出 ：无
*******************************************************************************/
void LEDdisplay()
{
		wela=1;
		LED_PORT=0x01;
		wela=0;
		LED_PORT=0;
		dula=1;
		LED_PORT=DisplayData[0];
		dula=0;
		Delayms(1);

		wela=1;
		LED_PORT=0x02;
		wela=0;
		LED_PORT=0;
		dula=1;
		LED_PORT=DisplayData[1];
		dula=0;
		Delayms(1);

		wela=1;
		LED_PORT=0x04;
		wela=0;
		LED_PORT=0;
		dula=1;
		LED_PORT=DisplayData[2];
		dula=0;
		Delayms(1);

		wela=1;
		LED_PORT=0x08;
		wela=0;
		LED_PORT=0;
		dula=1;
		LED_PORT=DisplayData[3];
		dula=0;
		Delayms(1);

		wela=1;
		LED_PORT=0x10;
		wela=0;
		LED_PORT=0;
		dula=1;
		LED_PORT=DisplayData[4];
		dula=0;
		Delayms(1);

		wela=1;
		LED_PORT=0x20;
		wela=0;
		LED_PORT=0;
		dula=1;
		LED_PORT=DisplayData[5];
		dula=0;
		Delayms(1); 
}

/*******************************************************************************
* 函 数 名 ：main
* 函数功能 ：主函数
* 输    入 ：无
* 输    出 ：无
*******************************************************************************/
void main()
{
	int i;
	Timer0Init();
	Timer1Init();
	TimeCount = 0;
	Freq = 0;
	for(i=0;i<6;i++) DisplayData[i] = table[i];
	while(1)
	{ 
		if(TR0 == 0)         //当计数器停下的时候，表明计数完毕
		{
			Freq = Freq + TL1;         //读取TL的值
			Freq = Freq + (TH1 * 256); //读取TH的值

			//--求频率的个十百千万十万位--//
			DisplayData[0] = table[Freq%1000000/100000];	
			DisplayData[1] = table[Freq%100000/10000];	
			DisplayData[2] = table[Freq%10000/1000];	
			DisplayData[3] = table[Freq%1000/100];	
			DisplayData[4] = table[Freq%100/10];	
			DisplayData[5] = table[Freq%10];
			
			//--显示完，重新计算下一次频率。--//	
			Freq = 0;//将计算的频率清零
			TH1 = 0; //将计数器的值清零
			TL1 = 0;
			TR0 = 1; //开启定时器
			TR1 = 1; //开启计数器	
		}

		//--显示求得的数值--//
		LEDdisplay();
	}
}

/*******************************************************************************
* 函 数 名 ：Timer0Int
* 函数功能 ：定时器0中断函数 ， 每隔TIME_MS ms进入
* 输    入 ：无
* 输    出 ：无
*******************************************************************************/
void Timer0Int() interrupt 1
{
	TH0=(65536-FOSC/12/1000*TIME_MS)/256;
	TL0=(65536-FOSC/12/1000*TIME_MS)%256;
	TimeCount++;
	if(TimeCount==20)//计时到1S
	{
		TR0=0;
		TR1=0;
		TimeCount=0;		
	}
}

/*******************************************************************************
* 函 数 名 ：Timer1Int
* 函数功能 ：定时器1中断函数
* 输    入 ：无
* 输    出 ：无
*******************************************************************************/
void Timer1Int()	interrupt 3
{	
	//--进入一次中断，表明计数到了65536--//
	Freq=Freq+65536;		
}

