/********************************* 深圳市航太电子有限公司 *******************************
* 实 验 名 ：LCD1602液晶实验
* 实验说明 ：设定的文字向右滑动显示
* 实验平台 ：航太51单片机开发板 V1.2
* 连接方式 ：LCD1602液晶模块直接插到LCD1602接口上
* 注    意 ：注意模块上的1,16标志引脚和接口上的1,16标志对应
*            如果LCD1602显示异常，请检查跳线帽CN26（方波发生器）是否已经断开，另外还可以调节电位器RP1调节LCD1602的背光
* 作    者 ：航太电子产品研发部    QQ ：1909197536
* 店    铺 ：http://shop120013844.taobao.com/
****************************************************************************************/

#include <reg52.h>
#include <intrins.h>

#define FOSC 11059200L //晶振设置，默认使用11.0592M Hz
//#define FOSC 12000000L //晶振设置，使用12M Hz
//#define FOSC 24000000L //晶振设置，使用24M Hz

//IO接口定义
#define LCD_PORT P0
sbit lcd_rs=P3^5;
sbit lcd_en=P3^4;
sbit lcd_rw=P3^6;

//全局变量定义
unsigned char code table1[]="Hantech MCU";
unsigned char code table2[]="Hello World";

/*******************************************************************************
* 函 数 名 ：Delayms
* 函数功能 ：实现 ms级的延时
* 输    入 ：ms
* 输    出 ：无
*******************************************************************************/
void Delayms(unsigned int ms)
{
	unsigned int i,j;
	for(i=0;i<ms;i++)
	#if FOSC == 11059200L
		for(j=0;j<114;j++);
	#elif FOSC == 12000000L
	  for(j=0;j<123;j++);
	#elif FOSC == 24000000L
		for(j=0;j<249;j++);
	#else
		for(j=0;j<114;j++);
	#endif
}

/*******************************************************************************
* 函 数 名 ：Delayus
* 函数功能 ：实现 us级的延时
* 输    入 ：us
* 输    出 ：无
*******************************************************************************/
void Delayus(unsigned int us)
{
	unsigned int i;
	for(i=0;i<us;i++);
}

/*******************************************************************************
* 函 数 名 ：LcdBusy
* 函数功能 ：检查LCD忙状态,LcdBusy 为1时，忙，等待。lcd-busy为0时,闲，可写指令与数据
* 输    入 ：无
* 输    出 ：状态
*******************************************************************************/
bit LcdBusy()
 {                          
    bit result;
    lcd_rs = 0;
    lcd_rw = 1;
    lcd_en = 1;
    Delayus(1);
    result = (bit)(P0&0x80);
    lcd_en = 0;
    return(result); 
}
 
/*******************************************************************************
* 函 数 名 ：write_com
* 函数功能 ：LCD1602 写指令
* 输    入 ：无
* 输    出 ：无
*******************************************************************************/
void LcdWriteCom(unsigned char com)
{
	while(LcdBusy());
	LCD_PORT=com;
	lcd_rs=0;
	lcd_rw = 0;
	lcd_en=0;
	Delayus(5);
	lcd_en=1;
	Delayus(5);
	lcd_en=0;
	Delayus(5);
}

/*******************************************************************************
* 函 数 名 ：write_com
* 函数功能 ：LCD1602 写数据
* 输    入 ：无
* 输    出 ：无
*******************************************************************************/
void LcdWriteDate(unsigned char date)
{
	while(LcdBusy());
	LCD_PORT=date;
	lcd_rs=1;
	lcd_rw = 0;
	lcd_en=0;
	Delayus(5);
	lcd_en=1;
	Delayus(5);
	lcd_en=0; 
	Delayus(5);	
}

/*******************************************************************************
* 函 数 名 ：LCD1602Init
* 函数功能 ：LCD1602初始化
* 输    入 ：无
* 输    出 ：无
*******************************************************************************/
void LCD1602Init()
{
	LcdWriteCom(0x38);  //设置16*2显示，8位数据接口
	LcdWriteCom(0x0f); //开显示，显示光标且闪烁
	LcdWriteCom(0x06);//写一个指针自动加一
	LcdWriteCom(0x01);//清屏     
}
  
/*******************************************************************************
* 函 数 名 ：main
* 函数功能 ：主函数
* 输    入 ：无
* 输    出 ：无
*******************************************************************************/
void main()
{
	unsigned char index;
	LCD1602Init();
	Delayms(100);//延时一段时间时间，等待LCD1602稳定
	
	LcdWriteCom(0x80+17);//设置第一行 数据地址指针，先存储在屏外
	for(index=0;index<11;index++)
	{
		LcdWriteDate(table1[index]);  //写入数据             
	}
	
	LcdWriteCom(0xc0+17);     //设置第二行 数据地址指针，先存储在屏外
	for(index=0;index<11;index++)
	{
		LcdWriteDate(table2[index]);  //写入数据             
	}
	
	for(index=0;index<16;index++)
	{
		LcdWriteCom(0x18);//画面整体左移
		Delayms(300);
	}
	while(1);	
}
