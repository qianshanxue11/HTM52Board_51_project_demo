/********************************* 深圳市航太电子有限公司 *******************************
* 实 验 名 ：蓝牙实验
* 实验说明 ：蓝牙与手机APP连接成功后，LCD1602显示蓝牙接收的数据，并回传接收数据的逆序
* 实验平台 ：航太51单片机开发板 V1.2
* 连接方式 ：跳线帽CN21，引脚1,3相接，引脚2,4相接;LCD1602插入到LCD1602接口;
*            手机APP与蓝牙连接成功后蓝牙模块LED灯保持常亮
* 注    意 ：1.晶振使用11.0592MHz，波特率选择9600，8位，无校验，1停止位
*            2.由于蓝牙也使用了串口连接，在烧录程序前需要先断开蓝牙模块，否则烧录不成功
*			 3.如果LCD屏无显示，请调节LCD屏右边的RP1电位器实现背光调节
* 作    者 ：航太电子产品研发部    QQ ：1909197536
* 店    铺 ：http://shop120013844.taobao.com/
****************************************************************************************/
#include<reg52.h>
#include <intrins.h>

#define FOSC 11059200L
#define T1MS (65536-FOSC/12/1000)   //1ms timer calculation method in 12T mode
#define delayNOP(); {_nop_();_nop_();_nop_();_nop_();};

#define LCD_PORT P0
sbit lcd_rs=P3^5;
sbit lcd_en=P3^4;
sbit lcd_rw=P3^6;

unsigned char tick_1ms;//1ms计数
data unsigned char rec_buf[16];//接收到的数据，不可以超过16个
data unsigned char rec_count;//接收数据个数计数
bit rec_flag;//接收一串数据成功标志

unsigned char code  cdis1[ ] = {"BuleTooth Data: "};

/*******************************************************************************
* 函 数 名 ：Delayus
* 函数功能 ：实现 us级的延时
* 输    入 ：us
* 输    出 ：无
*******************************************************************************/
void Delayus(unsigned int us)
{
	unsigned int i;
	for(i=0;i<us;i++);
}

/*******************************************************************************
* 函 数 名 ：LcdBusy
* 函数功能 ：检查LCD忙状态,LcdBusy 为1时，忙，等待。lcd-busy为0时,闲，可写指令与数据
* 输    入 ：无
* 输    出 ：状态
*******************************************************************************/
bit LcdBusy()
 {                          
    bit result;
    lcd_rs = 0;
    lcd_rw = 1;
    lcd_en = 1;
    Delayus(1);
    result = (bit)(P0&0x80);
    lcd_en = 0;
    return(result); 
}

/*******************************************************************************
* 函 数 名 ：LcdWriteCom
* 函数功能 ：LCD1602 写指令
* 输    入 ：无
* 输    出 ：无
*******************************************************************************/
void LcdWriteCom(unsigned char com)
{
	while(LcdBusy());
	LCD_PORT=com;
	lcd_rs=0;
	lcd_rw = 0;
	lcd_en=0;
	Delayus(5);
	lcd_en=1;
	Delayus(5);
	lcd_en=0;
	Delayus(5);
}

/*******************************************************************************
* 函 数 名 ：LcdWriteCom
* 函数功能 ：LCD1602 写数据
* 输    入 ：无
* 输    出 ：无
*******************************************************************************/
void LcdWriteDate(unsigned char date)
{
	while(LcdBusy());
	LCD_PORT=date;
	lcd_rs=1;
	lcd_rw = 0;
	lcd_en=0;
	Delayus(5);
	lcd_en=1;
	Delayus(5);
	lcd_en=0; 
	Delayus(5);	
}

/*******************************************************************************
* 函 数 名 ：Delayms
* 函数功能 ：实现 ms级的延时
* 输    入 ：ms
* 输    出 ：无
*******************************************************************************/
void Delayms(unsigned int ms)
{
	unsigned int i,j;
	for(i=0;i<ms;i++)
		for(j=0;j<114;j++);
}

/*******************************************************************************
* 函 数 名 ：LCD1602Init
* 函数功能 ：LCD1602初始化
* 输    入 ：无
* 输    出 ：无
*******************************************************************************/
void LCD1602Init()
{ 
    Delayms(15);                   
    LcdWriteCom(0x38);      //16*2显示，5*7点阵，8位数据
    Delayms(5);
    LcdWriteCom(0x38);         
    Delayms(5);
    LcdWriteCom(0x38);         
    Delayms(5);

    LcdWriteCom(0x0c);      //显示开，关光标
    Delayms(5);
    LcdWriteCom(0x06);      //移动光标
    Delayms(5);
    LcdWriteCom(0x01);      //清除LCD的显示内容
    Delayms(5);
}

/*******************************************************************************
* 函 数 名 ：SendBuf
* 函数功能 ：发送一段字符到串口
* 输    入 ：buf 要发送的字符数组    length 字符长度
* 输    出 ：无
*******************************************************************************/
void SendBuf(unsigned char *buf,unsigned char length)
{
	int i;
	for(i=0;i<length;i++)
	{
		SBUF=buf[length-i-1]; //将接收到的数据放入到发送寄存器
		while(!TI);		  //等待发送数据完成
		TI=0;			  //清除发送完成标志位
	}
}

/*******************************************************************************
* 函 数 名 ：Lcd1602Pos
* 函数功能 ：设定显示位置
* 输    入 ：pos 偏移位置
* 输    出 ：无
*******************************************************************************/
void Lcd1602Pos(unsigned char pos)
{                          
  LcdWriteCom(pos | 0x80);  //数据指针=80+地址变量
}

/*******************************************************************************
* 函 数 名 ：SystemInit
* 函数功能 ：系统初始化
* 输    入 ：无
* 输    出 ：无
*******************************************************************************/
void SystemInit()
{
	SCON=0X50;			//设置为工作方式1
	TMOD=0X20;			//设置计数器工作方式2
	TH1=0XFd;		    //计数器初始值设置，注意波特率是9600的
	TL1=0XFd;
	ES=1;						//打开接收中断
	TR1=1;					    //打开计数器
	
	//配置定时器0
    TMOD = TMOD | 0x01;                    //set timer0 as mode1 (16-bit)
    TL0 = T1MS;                     //initial timer0 low byte
    TH0 = T1MS >> 8;                //initial timer0 high byte
    TR0 = 1;                        //timer0 start running
    ET0 = 1;                        //enable timer0 interrupt
	EA=1;	//打开总中断
}

/*******************************************************************************
* 函 数 名 ：main
* 函数功能 ：主函数
* 输    入 ：无
* 输    出 ：无
*******************************************************************************/
void main()
{
	int m;
	SystemInit();
	LCD1602Init();
	
	Lcd1602Pos(0);                //设置显示位置为第一行的第1个字符
    for(m=0;m<16;m++)
    LcdWriteDate(cdis1[m]);

	while(1)
	{
		if(rec_flag == 1)
		{
			Lcd1602Pos(40);   //设置显示位置为第一行的第1个字符
			for(m=0;m<rec_count;m++)
				LcdWriteDate(rec_buf[m]);
			for(;m<16;m++)
				LcdWriteDate(' ');//清空后面的数据
			
			SendBuf(rec_buf,rec_count);
			rec_count = 0;
			rec_flag = 0;
		}
	}
}

/*******************************************************************************
* 函 数 名 ：Usart
* 函数功能 ：串口中断服务函数
* 输    入 ：无
* 输    出 ：无
*******************************************************************************/
void Usart() interrupt 4
{
	if(RI == 1)
	{
		RI = 0; //清除接收中断标志位
		tick_1ms = 0;
		if(rec_count == 16 || rec_flag == 1) return;//接收数据超过16个或未进入接收状态直接返回
		rec_buf[rec_count]=SBUF; //接收到的数据
		rec_count++;
	}
}

/*******************************************************************************
* 函 数 名 ：Time0Int
* 函数功能 ：定时器0中断服务函数
* 输    入 ：无
* 输    出 ：无
*******************************************************************************/
void Time0Int() interrupt 1
{
	TL0 = T1MS;                     //reload timer0 low byte
    TH0 = T1MS >> 8;                //reload timer0 high byte
	tick_1ms++;
	if(tick_1ms > 5 && rec_count>0)//接收到一串数据
	{
		rec_flag = 1;
	}
}

