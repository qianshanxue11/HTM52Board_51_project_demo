/********************************* 深圳市航太电子有限公司 *******************************
* 实 验 名 ：PWM直流电机实验
* 实验说明 ：单击按键s17加速，单击按键s20减速
* 实验平台 ：航太51单片机开发板 V1.3
* 连接方式 ：跳线帽CN9：引脚9，10短接； 跳线帽CN14：引脚1,2短接，引脚7,8短接
*            电机两个引脚分别接向CN15的两个引脚，不需要分正负极
* 注    意 ：1.当PWM为1时停止，为0时启动,PWM周期为5ms，脉宽 0%-100%可调
*            2.做该实验室，需要移除LCD1602，因为两个模块公用 P0^4 口，若必须使用LCD1602，
*              可以将短线帽CN9的引脚10改引到其他与1602不冲突的IO口上
*            3.电机启动时需要加大的电流，所以启动时占空比不可过小，导致电机不转而过热
* 作    者 ：航太电子产品研发部    QQ ：1909197536
* 店    铺 ：http://shop120013844.taobao.com/
****************************************************************************************/

#include <reg52.h>
#include <intrins.h>

#define FOSC 11059200L //晶振设置，默认使用11.0592M Hz
//#define FOSC 12000000L //晶振设置，使用12M Hz
//#define FOSC 24000000L //晶振设置，使用24M Hz

#define MAX_SPEED 80 // 最高占空比
#define MIN_SPEED 30 //最低占空比
#define TIME_US 50 //设定定时时间 us 
#define SPEED 2

//IO接口定义
sbit PWM=P0^2;
sbit key_inc = P3^4;
sbit key_dec = P3^7;
sbit LED = P1^0;

//全局变量定义
unsigned char timer1,speed; 
//LED显示字模 0-F 共阳模式
unsigned char code table[]= {0Xc0,0xf9,0xa4,0xb0,0x99,0x92,0x82,0xf8,0x80,0x90,0x88,0x83,0xc6,0xa1,0x86,0x8e};

/*******************************************************************************
* 函 数 名 ：Delayms
* 函数功能 ：实现 ms级的延时
* 输    入 ：ms
* 输    出 ：无
*******************************************************************************/
void Delayms(unsigned int ms)
{
	unsigned int i,j;
	for(i=0;i<ms;i++)
	#if FOSC == 11059200L
		for(j=0;j<114;j++);
	#elif FOSC == 12000000L
	  for(j=0;j<123;j++);
	#elif FOSC == 24000000L
		for(j=0;j<249;j++);
	#else
		for(j=0;j<114;j++);
	#endif
}


/*******************************************************************************
* 函 数 名 ：Timer0Init
* 函数功能 ：定时器0初始化
* 输    入 ：无
* 输    出 ：无
*******************************************************************************/
void Timer0Init()
{
	TMOD=0x01; //设置定时器0工作方式为1
	TH0=(65536-(FOSC/12*TIME_US)/1000000)/256;
	TL0=(65536-(FOSC/12*TIME_US)/1000000)%256;
	ET0=1; //开启定时器0中断
	TR0=1;	//开启定时器	
	EA=1;  //打开总中断
}

/*******************************************************************************
* 函 数 名 ：KeyScan
* 函数功能 ：按键扫描
* 输    入 ：无
* 输    出 ：无
*******************************************************************************/
void KeyScan(void)
{
		if(key_inc==0)
		{
			
			Delayms(5);
			if(key_inc==0);
			{	
			    while(key_inc==0);
				speed++;
				if(speed > MAX_SPEED)	speed = MAX_SPEED;
			}
		}
			if(key_dec==0)
		{
			Delayms(5);
			if(key_dec==0);
			{
			    while(key_dec==0);
				if(speed <= MIN_SPEED)	speed = MIN_SPEED;
				speed--;	
			}
		}
}

/*******************************************************************************
* 函 数 名 ：main
* 函数功能 ：主函数
* 输    入 ：无
* 输    出 ：无
*******************************************************************************/
void main()
{
	Timer0Init();
	speed = 30;
	while(1)
	{ 
		KeyScan();
	}
}

/*******************************************************************************
* 函 数 名 ：Timer0Int
* 函数功能 ：定时器0中断函数 ， 每隔TIME_US ms进入
* 输    入 ：无
* 输    出 ：无
*******************************************************************************/
void Timer0Int() interrupt 1
{
	TH0=(65536-(FOSC/12*TIME_US)/1000000)/256;
	TL0=(65536-(FOSC/12*TIME_US)/1000000)%256;
	timer1++;  
	if(timer1>100)  //PWM周期为100*0.05ms
	{
		timer1=0;
	}
	if(timer1 < speed)	//改变30这个值可以改变直流电机的速度
	{
		PWM=1;
		LED = 0;
	}
	else
	{
		PWM=0;
		LED = 1;
	}  
}
