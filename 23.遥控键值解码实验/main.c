/********************************* 深圳市航太电子有限公司 *******************************
* 实 验 名 ：遥控键值解码LCD1602
* 实验说明 ：烧录成功后，使用遥控器对着红外接收头按键，1602上会显示相应的键值，蜂鸣器也会响一声
* 实验平台 ：航太51单片机开发板 V1.2
* 连接方式 ：跳线帽CN20 引脚2,4相接，跳线帽CN3 引脚1,3相接
* 注    意 ：请务必断开跳线帽CN26
* 作    者 ：航太电子产品研发部    QQ ：1909197536
* 店    铺 ：http://shop120013844.taobao.com/
****************************************************************************************/

#include <reg52.h>
#include <intrins.h>

#define FOSC 11059200L //晶振设置，默认使用11.0592M Hz
//#define FOSC 12000000L //晶振设置，使用12M Hz
//#define FOSC 24000000L //晶振设置，使用24M Hz

//IO接口定义
#define LCD_PORT P0
sbit lcd_rs=P3^5;
sbit lcd_en=P3^4;
sbit lcd_rw=P3^6;

sbit IRIN = P3^2;         //红外接收器数据线
sbit BEEP = P1^5;         //蜂鸣器驱动线

//全局变量定义
unsigned char IRCOM[7];
unsigned char code  cdis1[ ] = {" REMOTE CONTROL "};
unsigned char code  cdis2[ ] = {"  IR-CODE: --H  "};

/*******************************************************************************
* 函 数 名 ：Delayms
* 函数功能 ：实现 ms级的延时
* 输    入 ：ms
* 输    出 ：无
*******************************************************************************/
void Delayms(unsigned int ms)
{
	unsigned int i,j;
	for(i=0;i<ms;i++)
	#if FOSC == 11059200L
		for(j=0;j<114;j++);
	#elif FOSC == 12000000L
	  for(j=0;j<123;j++);
	#elif FOSC == 24000000L
		for(j=0;j<249;j++);
	#else
		for(j=0;j<114;j++);
	#endif
}

/*******************************************************************************
* 函 数 名 ：Delayus
* 函数功能 ：实现 us级的延时
* 输    入 ：us
* 输    出 ：无
*******************************************************************************/
void Delayus(unsigned int us)
{
	unsigned int i;
	for(i=0;i<us;i++);
}

/*******************************************************************************
* 函 数 名 ：LcdBusy
* 函数功能 ：检查LCD忙状态,LcdBusy 为1时，忙，等待。lcd-busy为0时,闲，可写指令与数据
* 输    入 ：无
* 输    出 ：状态
*******************************************************************************/
bit LcdBusy()
 {                          
    bit result;
    lcd_rs = 0;
    lcd_rw = 1;
    lcd_en = 1;
    Delayus(1);
    result = (bit)(P0&0x80);
    lcd_en = 0;
    return(result); 
}
 
/*******************************************************************************
* 函 数 名 ：write_com
* 函数功能 ：LCD1602 写指令
* 输    入 ：无
* 输    出 ：无
*******************************************************************************/
void LcdWriteCom(unsigned char com)
{
	while(LcdBusy());
	LCD_PORT=com;
	lcd_rs=0;
	lcd_rw = 0;
	lcd_en=0;
	Delayus(5);
	lcd_en=1;
	Delayus(5);
	lcd_en=0;
	Delayus(5);
}

/*******************************************************************************
* 函 数 名 ：write_com
* 函数功能 ：LCD1602 写数据
* 输    入 ：无
* 输    出 ：无
*******************************************************************************/
void LcdWriteDate(unsigned char date)
{
	while(LcdBusy());
	LCD_PORT=date;
	lcd_rs=1;
	lcd_rw = 0;
	lcd_en=0;
	Delayus(5);
	lcd_en=1;
	Delayus(5);
	lcd_en=0; 
	Delayus(5);	
}

/*******************************************************************************
* 函 数 名 ：LCD1602Init
* 函数功能 ：LCD1602初始化
* 输    入 ：无
* 输    出 ：无
*******************************************************************************/
void LCD1602Init()
{
	LcdWriteCom(0x38);  //设置16*2显示，8位数据接口
	LcdWriteCom(0x0c); //开显示，光标关闭
	LcdWriteCom(0x06);//写一个指针自动加一
	LcdWriteCom(0x01);//清屏     
}

/*******************************************************************************
* 函 数 名 ：Exit0Init
* 函数功能 ：外中断0初始化程序
* 输    入 ：无
* 输    出 ：无
*******************************************************************************/
void Exit0Init()
{
	EX0 = 1;	//使能 INT1 外部中断
    IT0 = 1;	// 触发方式为脉冲负边沿触发
    EA = 1;//总中断
}  

/*******************************************************************************
* 函 数 名 ：beep
* 函数功能 ：蜂鸣器响一声
* 输    入 ：无
* 输    出 ：无
*******************************************************************************/
void beep()
{
  unsigned char i;
  for (i=0;i<180;i++)
   {
     Delayms(1);
     BEEP=!BEEP;                 //BEEP取反
   } 
  BEEP=1;                      //关闭蜂鸣器
}

/*******************************************************************************
* 函 数 名 ：DelayIr
* 函数功能 ：0.14MS 延时
* 输    入 ：无
* 输    出 ：无
*******************************************************************************/
void DelayIr(unsigned char x)  
{
 unsigned char i;
  while(x--)
 {
  for (i = 0; i<13; i++) {}
 }
}

/*******************************************************************************
* 函 数 名 ：main
* 函数功能 ：主函数
* 输    入 ：无
* 输    出 ：无
*******************************************************************************/
void main()
{
	unsigned char index;
	IRIN=1;                    //I/O口初始化
    BEEP=1;
	Exit0Init();
	LCD1602Init();
	Delayms(100);//延时一段时间时间，等待LCD1602稳定
	
	LcdWriteCom(0x80);//设置第一行 数据地址指针
	for(index=0;index<16;index++)
	{
		LcdWriteDate(cdis1[index]);  //写入数据             
	}
	
	LcdWriteCom(0xc0);     //设置第二行 数据地址指针
	for(index=0;index<16;index++)
	{
		LcdWriteDate(cdis2[index]);  //写入数据             
	}
	
	while(1);	
}

/*******************************************************************************
* 函 数 名 ：Exit0Int
* 函数功能 ：外部中断0 ISR
* 输    入 ：无
* 输    出 ：无
*******************************************************************************/
void Exit0Int() interrupt 0 
{
  unsigned char j,k,N=0;

     EX0 = 0;   
	 DelayIr(15);
	 if (IRIN==1) 
     { EX0 =1;
	   return;
	  } 
                           //确认IR信号出现
  while (!IRIN)            //等IR变为高电平，跳过9ms的前导低电平信号。
    {DelayIr(1);}

 for (j=0;j<4;j++)         //收集四组数据
 { 
  for (k=0;k<8;k++)        //每组数据有8位
  {
   while (IRIN)            //等 IR 变为低电平，跳过4.5ms的前导高电平信号。
     {DelayIr(1);}
    while (!IRIN)          //等 IR 变为高电平
     {DelayIr(1);}
     while (IRIN)           //计算IR高电平时长
      {
    DelayIr(1);
    N++;           
    if (N>=30)
	 { EX0=1;
	 return;}                  //0.14ms计数过长自动离开。
      }                        //高电平计数完毕                
     IRCOM[j]=IRCOM[j] >> 1;                  //数据最高位补“0”
     if (N>=8) {IRCOM[j] = IRCOM[j] | 0x80;}  //数据最高位补“1”
     N=0;
  }//end for k
 }//end for j
   
   if (IRCOM[2]!=~IRCOM[3])
   { EX0=1;
     return; }

   IRCOM[5]=IRCOM[2] & 0x0F;     //取键码的低四位
   IRCOM[6]=IRCOM[2] >> 4;       //右移4次，高四位变为低四位

   if(IRCOM[5]>9)
    { IRCOM[5]=IRCOM[5]+0x37;}
   else
	  IRCOM[5]=IRCOM[5]+0x30;

   if(IRCOM[6]>9)
    { IRCOM[6]=IRCOM[6]+0x37;}
   else
	  IRCOM[6]=IRCOM[6]+0x30;

     LcdWriteCom(0xc0 + 11);             
     LcdWriteDate(IRCOM[6]);        //第一位数显示 
     LcdWriteCom(0xc0 + 12);             
     LcdWriteDate(IRCOM[5]);        //第二位数显示

     beep();
     EX0 = 1; 
} 




