/********************************* 深圳市航太电子有限公司 *******************************
* 实 验 名 ：静态数码管实验
* 实验说明 ：6位数码管循环显示16进制0~F
* 实验平台 ：航太51单片机开发板 V1.2
* 连接方式 ：
* 注    意 ：
* 作    者 ：航太电子产品研发部    QQ ：1909197536
* 店    铺 ：http://shop120013844.taobao.com/
****************************************************************************************/

#include <reg52.h>
#include <intrins.h>

#define FOSC 11059200L //晶振设置，默认使用11.0592M Hz
//#define FOSC 12000000L //晶振设置，使用12M Hz
//#define FOSC 24000000L //晶振设置，使用24M Hz

//IO接口定义
#define LED_PORT P0
sbit dula=P2^6;
sbit wela=P2^7;

//全局变量定义
unsigned char num;

//LED显示字模 0-F 共阳模式
unsigned code table[]= {0Xc0,0xf9,0xa4,0xb0,0x99,0x92,0x82,0xf8,0x80,0x90,0x88,0x83,0xc6,0xa1,0x86,0x8e};

/*******************************************************************************
* 函 数 名 ：Delayms
* 函数功能 ：实现 ms级的延时
* 输    入 ：ms
* 输    出 ：无
*******************************************************************************/
void Delayms(unsigned int ms)
{
	unsigned int i,j;
	for(i=0;i<ms;i++)
	#if FOSC == 11059200L
		for(j=0;j<114;j++);
	#elif FOSC == 12000000L
	  for(j=0;j<123;j++);
	#elif FOSC == 24000000L
		for(j=0;j<249;j++);
	#else
		for(j=0;j<114;j++);
	#endif
}

/*******************************************************************************
* 函 数 名 ：main
* 函数功能 ：主函数
* 输    入 ：无
* 输    出 ：无
*******************************************************************************/
void main()
{
   wela=1;	  //打开数码管共阳端
   LED_PORT=0xff;
   wela=0;	 //锁存数据
   dula = 1;//打开段锁存
   while(1)
   {
      for(num=0;num<16;num++) //循环写数据到LED_PORT 口
      {   
         LED_PORT=table[num];  //数组是按共阳的方式取的
         Delayms(1000);
      }
   }
}
