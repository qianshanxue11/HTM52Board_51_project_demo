/********************************* 深圳市航太电子有限公司 *******************************
* 实 验 名 ：TFT彩屏图片显示
* 实验说明 ：显示一副图片到屏幕上，并移动
* 实验平台 ：航太51单片机开发板 V1.2
* 连接方式 ：TFT彩屏朝外连接
* 注    意 ：
* 作    者 ：航太电子产品研发部    QQ ：1909197536
* 店    铺 ：http://shop120013844.taobao.com/
****************************************************************************************/
#include<reg52.h>
#include <intrins.h>
#include "TFT.h"

//#define FOSC 11059200L //晶振设置，默认使用11.0592M Hz
//#define FOSC 12000000L //晶振设置，使用12M Hz
#define FOSC 24000000L //晶振设置，使用24M Hz

sbit DULA = P2^6;
sbit WELA = P2^7;

/*******************************************************************************
* 函 数 名 ：Delayms
* 函数功能 ：实现 ms级的延时
* 输    入 ：ms
* 输    出 ：无
*******************************************************************************/
void Delayms(unsigned int ms)
{
	unsigned int i,j;
	for(i=0;i<ms;i++)
	#if FOSC == 11059200L
		for(j=0;j<114;j++);
	#elif FOSC == 12000000L
	  for(j=0;j<123;j++);
	#elif FOSC == 24000000L
		for(j=0;j<249;j++);
	#else
		for(j=0;j<114;j++);
	#endif
}

/*******************************************************************************
* 函 数 名: main
* 函数功能: 主函数
* 输    入: 无
* 输    出: 无
*******************************************************************************/
void main()
{
	unsigned char i = 0;
	
	//彩屏实验时最好关闭数码管的锁存器，避免数码管乱闪
	DULA = 1;
	P0 = 0xff;
	DULA = 0;
	WELA = 1;
	P0 = 0xff;
	WELA = 0;
	
	LcdInit();
	CLeanFullScreen(0xff,0xff);//清屏
	
	while (1)
	{
		ShowPic(20,30 + i*70,logo);//显示图片
		Delayms(1000);
		CleanRect(20,30 + i*70,logo.x_pix,logo.y_pix);//清除图片
		i++;
		if(i == 4) i = 0;
	}
}

