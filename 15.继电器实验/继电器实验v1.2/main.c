/********************************* 深圳市航太电子有限公司 *******************************
* 实 验 名 ：继电器实验
* 实验说明 ：继电器循环导通和断开
* 实验平台 ：航太51单片机开发板 V1.2
* 连接方式 ：短路帽CN9 短接引脚11，12
* 注    意 ：1.做该实验时，请务必弄清继电器原理及该如何连接。
*            2.继电器吸合时会有较大的电流，可能会影响开机时的程序下载，建议做完该实验后，
*            断开短路帽CN9的11，,12引脚，以免影响其他实验
* 作    者 ：航太电子产品研发部    QQ ：1909197536
* 店    铺 ：http://shop120013844.taobao.com/
****************************************************************************************/

#include <reg52.h>
#include <intrins.h>

#define FOSC 11059200L //晶振设置，默认使用11.0592M Hz
//#define FOSC 12000000L //晶振设置，使用12M Hz
//#define FOSC 24000000L //晶振设置，使用24M Hz

//IO接口定义
sbit RELAY = P0^5;

//全局变量定义

/*******************************************************************************
* 函 数 名 ：Delayms
* 函数功能 ：实现 ms级的延时
* 输    入 ：ms
* 输    出 ：无
*******************************************************************************/
void Delayms(unsigned int ms)
{
	unsigned int i,j;
	for(i=0;i<ms;i++)
	#if FOSC == 11059200L
		for(j=0;j<114;j++);
	#elif FOSC == 12000000L
	  for(j=0;j<123;j++);
	#elif FOSC == 24000000L
		for(j=0;j<249;j++);
	#else
		for(j=0;j<114;j++);
	#endif
}

/*******************************************************************************
* 函 数 名 ：main
* 函数功能 ：主函数
* 输    入 ：无
* 输    出 ：无
*******************************************************************************/
void main()
{
	while(1)
	{
		RELAY = 0; //常开触点断开，常闭触点闭合
		Delayms(1000);
		RELAY = 1; //常开触点闭合，常闭触点断开
		Delayms(1000);
	}	
}
